/dts-v1/;
/plugin/;

#include "xiaomi-sm8450-common.dtsi"

/ {
	model = "Qualcomm Technologies, Inc. Ukee MTP";
	compatible = "qcom,ukee-mtp", "qcom,ukee", "qcom,mtp";
	qcom,msm-id = <591 0x10000>;
	qcom,board-id = <0x10008 0>;
	xiaomi,miboard-id = <0xF 0>;
};

&waipio_snd {
	/delete-property/qcom,uart-audio-sw-gpio;
	qcom,model = "ukee-mtp-snd-card";
};

&swr_haptics {
	status = "ok";
};

&adsp_loader {
	adsp-fuse-not-supported = <1>;
	adsp-fw-name = "adsp2.mdt";
};
